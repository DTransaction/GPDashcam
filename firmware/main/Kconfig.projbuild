## firmware/main/Kconfig.projbuild
```kconfig
menu "GPDashcam configuration"
	menu "Camera"
		menu "Camera pins"
			config CAM_PIN_RESET   
				int "CAM_PIN_RESET" 
				default -1
			config CAM_PIN_XCLK    
				int "CAM_PIN_XCLK"
				default 15
			config CAM_PIN_SIOD    
				int "CAM_PIN_SIOD"
				default 4
			config CAM_PIN_SIOC    
				int "CAM_PIN_SIOC" 
				default 5
			config CAM_PIN_D0      
				int "CAM_PIN_D0"
				default 11
			config CAM_PIN_D1      
				int "CAM_PIN_D1"
				default 9
			config CAM_PIN_D2      
				int "CAM_PIN_D2"
				default 8
			config CAM_PIN_D3      
				int "CAM_PIN_D3"       
				default 10
			config CAM_PIN_D4      
				int "CAM_PIN_D4"       
				default 12
			config CAM_PIN_D5      
				int "CAM_PIN_D5"       
				default 18
			config CAM_PIN_D6      
				int "CAM_PIN_D6"       
				default 17
			config CAM_PIN_D7      
				int "CAM_PIN_D7"       
				default 16
			config CAM_PIN_VSYNC   
				int "CAM_PIN_VSYNC"    
				default 6
			config CAM_PIN_HREF    
				int "CAM_PIN_HREF"     
				default 7
			config CAM_PIN_PCLK    
				int "CAM_PIN_PCLK"     
				default 13
		endmenu
	endmenu
	menu "I2C"
		config SDA_PIN_NUM
			int "SDA pin number"
			default 1
		config SCL_PIN_NUM
			int "SCL pin number"
			default 2
	endmenu
	menu "Accelerometer"
		config IMPACT_GFORCE_THRESHOLD
			int "Impact G-force threshold"
			default 2
		config POLL_RATE
			int "Poll rate"
			default 10
	endmenu
	menu "Display"
		config REFRESH_RATE
			int "Display refresh rate (Hz)"
			default 10
	endmenu
	menu "GPIO"
		config GPIO_INPUT0
			int "GPIO input 0 pin number"
			default 14
		config GPIO_INPUT1
			int "GPIO input 1 pin number"
			default 48
		config DEBOUNCE_TIME_MS
			int "Button debounce time in ms"
			default 40
	endmenu
	menu "GPS"
		config TRAFFIC_CAMERA_DISTANCE_TRIGGER
			int "Traffic camera distance trigger"
			default 250
		config TIME_ZONE
			int "Time zone offset"
			default -4 
	endmenu
	menu "UART"
		config RX_PIN_NUM
			int "RX pin number"
			default 42
	endmenu
	menu "SD"
		config CMD_PIN_NUM
			int "CMD pin number" 
			default 38
		config CLK_PIN_NUM
			int "CLK pin number"
			default 39
		config D0_PIN_NUM
			int "D0 pin number"
			default 47
		config D1_PIN_NUM
			int "D1 pin number"
			default 21 
		config D2_PIN_NUM
			int "D2 pin number"
			default 41
		config D3_PIN_NUM
			int "D3 pin number"
			default 40
	endmenu
	menu "WiFi AP"
		config ESP_WIFI_SSID
			string "WiFi SSID"
			default "GPDashcam"
		config ESP_WIFI_PASSWORD
			string "WiFi Password"
			default "areallylongpassword"
		config ESP_WIFI_CHANNEL
			int "WiFi Channel"
			range 1 13
			default 1
		config ESP_MAX_STA_CONN
			int "Maximal STA connections"
			default 4
			help
				Max number of the STA connects to AP.
		config ESP_GTK_REKEYING_ENABLE
			bool "Enable GTK Rekeying"
			default y
		config ESP_GTK_REKEY_INTERVAL
			int "GTK rekey interval"
			depends on ESP_GTK_REKEYING_ENABLE
			range 60 65535
			default 600
			help
				GTK rekeying interval in seconds.
	endmenu
endmenu
```
